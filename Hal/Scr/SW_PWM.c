/**********************************************************************************************************************
 *  FILE DESCRIPTION
 *  -----------------------------------------------------------------------------------------------------------------*/
/**        \file  SW_PWM.c
 *        \brief  Digital Input Output Driver
 *
 *      \details  The Driver Configure Pins 
 *                Enable CLock Gate for External Peripherals
 *
 *********************************************************************************************************************/

/**********************************************************************************************************************
 *  INCLUDES
 *********************************************************************************************************************/
#include "Std_Types.h"
#include "MCU_HW.h"
#include "SW_PWM_Types.h"
#include "SW_PWM.h"
#include "GPT_Types.h"
#include "GPT.h"
#include "Dio_Types.h"
#include "Dio.h"

/**********************************************************************************************************************
*  LOCAL MACROS CONSTANT\FUNCTION
*********************************************************************************************************************/	
volatile uint8 onTime;
volatile uint8 offTime;
/**********************************************************************************************************************
 *  LOCAL DATA 
 *********************************************************************************************************************/

/**********************************************************************************************************************
 *  GLOBAL DATA
 *********************************************************************************************************************/

/**********************************************************************************************************************
 *  LOCAL FUNCTION PROTOTYPES
 *********************************************************************************************************************/

/**********************************************************************************************************************
 *  LOCAL FUNCTIONS
 *********************************************************************************************************************/

/**********************************************************************************************************************
 *  GLOBAL FUNCTIONS
 *********************************************************************************************************************/

 /******************************************************************************
* \Syntax          : void SWPWM_init(uint32_t frequency_kh, uint8_t dutyCycle)                                  
* \Description     :  initiate PWM
*                                                       
*                                                                             
* \Sync\Async      : Synchronous                                               
* \Reentrancy      : Non Reentrant                                             
* \Parameters (in) : frequency  - dutycucle                   
* \Parameters (out): None                                                      
* \Return value:   : None
*******************************************************************************/
void SWPWM_init(uint32 frequency_kh, uint8 dutyCycle)
{
    Timer_init(frequency_kh);
	
	onTime = dutyCycle;
	offTime = 100 - dutyCycle;
}
void SWPWM_changeDutyCycle(uint8 dutyCycle)
{
	onTime = dutyCycle;
	offTime = 100 - dutyCycle;
}
 /******************************************************************************
* \Syntax          : void delay(uint16 value)                                  
* \Description     :  delay function
*                                                       
*                                                                             
* \Sync\Async      : Synchronous                                               
* \Reentrancy      : Non Reentrant                                             
* \Parameters (in) : value                  
* \Parameters (out): None                                                      
* \Return value:   : None
*******************************************************************************/
void delay(uint16 value)
{
	Timer_set( value);
	Timer_start();
	// wait untile count finsh
	while(!(getBit(TIM2->SR, 0)));
 	TIM2->SR &=~ 1;

}

 /******************************************************************************
* \Syntax          : void SWPWM_START(void)                                  
* \Description     :  Start PWM
*                                                       
*                                                                             
* \Sync\Async      : Synchronous                                               
* \Reentrancy      : Non Reentrant                                             
* \Parameters (in) : None                  
* \Parameters (out): None                                                      
* \Return value:   : None
*******************************************************************************/
void SWPWM_START(void)
{
	while(1)
	{
		DIO_write(7, 'A',HIGH);
		delay(onTime);
		DIO_write(7, 'A',LOW);
		delay(offTime);
		if(onTime<100)
			SWPWM_changeDutyCycle(onTime+1);
		else
			SWPWM_changeDutyCycle(0);
	}	
}

void SWPWM_stop(void)
{
	Timer_Stop();
}
/**********************************************************************************************************************
 *  END OF FILE: SW_PWM.c
 *********************************************************************************************************************/







  





